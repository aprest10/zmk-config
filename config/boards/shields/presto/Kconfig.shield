## config/boards/shields/presto/Kconfig.shield
```kconfig
config SHIELD_PRESTO_LEFT
    def_bool $(shields_list_contains,presto_left)

config SHIELD_PRESTO_RIGHT
    def_bool $(shields_list_contains,presto_right)
```

## config/west.yml
```yaml
manifest:
  remotes:
    - name: aprest10
      url-base: https://github.com/aprest10
  projects:
    - name: zmk
      remote: aprest10
      revision: main
      import: config/west.yml
  self:
    path: config
```
